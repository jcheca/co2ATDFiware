
#define _DEBUG_;

#include <Arduino.h>
#include <SoftwareSerial.h> // Remove if using HardwareSerial

//#include <SPI.h>
//#include <Wire.h>
//#include <Adafruit_GFX.h>
//#include <Adafruit_SSD1306.h>

//#define SCREEN_WIDTH 128 // OLED display width, in pixels
//#define SCREEN_HEIGHT 32 // OLED display height, in pixels

// Declaration for an SSD1306 display connected to I2C (SDA, SCL pins)
// The pins for I2C are defined by the Wire-library. 
// On an arduino UNO:       A4(SDA), A5(SCL)
// On an arduino MEGA 2560: 20(SDA), 21(SCL)
// On an arduino LEONARDO:   2(SDA),  3(SCL), ...
//#define OLED_RESET     -1 // Reset pin # (or -1 if sharing Arduino reset pin)
//Adafruit_SSD1306 display(SCREEN_WIDTH, SCREEN_HEIGHT, &Wire, OLED_RESET);

// 'atd', 128x32px
const unsigned char myBitmap [] PROGMEM = {
  0xff, 0xff, 0xff, 0xff, 0xff, 0xff, 0xff, 0xff, 0xfc, 0x3f, 0xff, 0xff, 0xff, 0xff, 0xff, 0xff, 
  0xff, 0xff, 0xff, 0xff, 0xff, 0xff, 0xff, 0xff, 0xfc, 0x1f, 0xff, 0xff, 0xff, 0xff, 0xff, 0xff, 
  0xff, 0xff, 0xff, 0xff, 0xff, 0xff, 0xff, 0xff, 0xf8, 0x1f, 0xff, 0xff, 0xff, 0xff, 0xff, 0xff, 
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  0xff, 0xff, 0xff, 0xff, 0xff, 0xff, 0xff, 0xff, 0xff, 0xff, 0xff, 0xff, 0xff, 0xff, 0xff, 0xff
};

//
// FiWare
//
#include <ESP8266WiFi.h>
#include <ESP8266HTTPClient.h>
#include <ArduinoJson.h>

const char* ssid = "<ssid>";
const char* password = "<passwd>";


// FiWare Config UL IoTAgent
const String host = "<Ultralight Fiware Server>";
const String port = "<por>";
const String apik = "<group token>";
const String deid = "<device_id>";

// FiWare POST URL
String urlpost = "http://"+host+":"+port+"/iot/d?k="+apik+"&i="+deid+"&getCmd=0";

// Peticiones WEB
HTTPClient http;

//
// Declaración pinout Serial Comunication
//

#define RX_PIN 14                                          // Rx pin which the MHZ19 Tx pin is attached to
#define TX_PIN 12                                          // Tx pin which the MHZ19 Rx pin is attached to
#define BAUDRATE 9600                                      // Device to MH-Z14a Serial baudrate (should not be changed)

// Sensor MHZ14A + Comando
SoftwareSerial mySerial(RX_PIN, TX_PIN);
const unsigned long MHZ14A_PREHEATING_TIME = 3L * 60L * 1000L;
const byte leerCO2[] = {0xFF, 0x01, 0x86, 0x00, 0x00, 0x00, 0x00, 0x00, 0x79};

// Variables
unsigned long getDataTimer = 0;
unsigned long DataTimer = 2 * 1000;
unsigned long getDataPost = 0;
unsigned long DataPost = 300 * 1000;
int val = 0;
int CO2 = 0;

void setup()
{
    Serial.begin(9600);                                     // Device to serial monitor feedback
    mySerial.begin(BAUDRATE);

    // SSD1306_SWITCHCAPVCC = generate display voltage from 3.3V internally
    //if(!display.begin(SSD1306_SWITCHCAPVCC, 0x3C)) { // Address 0x3C for 128x32
    //  Serial.println(F("SSD1306 allocation failed"));
    //  for(;;); // Don't proceed, loop forever
    //}

    // Show initial display buffer contents on the screen --
    // the library initializes this with an Adafruit splash screen.
    // display.display();

    //testdrawbitmap();
    //delay(2000); // Pause for 2 seconds

    // Enviar a pantalla
    // display.display();


  if (isPreHeating()) {
    Serial.print("Preheating");
    while (isPreHeating()) {
      Serial.print(".");
      delay(5000);
    }
    Serial.println();
  }    
  
   // Conectar WiFi
   WiFi.begin(ssid, password);
   while (WiFi.status() != WL_CONNECTED) 
      delay(500); 

}




void loop()
{
    if (millis() - getDataTimer >= DataTimer)
    {

        // Read Sensor Buffer
        byte bufferCO2[9];
        mySerial.write(leerCO2, 9);
        mySerial.readBytes(bufferCO2, 9);

        // Get/convert values from buffer
        int CO2 = bufferCO2[2] * 256 + bufferCO2[3];
        float Temp_1 = bufferCO2[4] - 44;

        // Callibrate con UrsaLink
        //Temp_1 = Temp_1 + 4;
        //CO2 = CO2 + 205;

        #ifdef _DEBUG_
          Serial.print("PPMuart: ");
          if (CO2 > 0) {
            Serial.print(CO2);
          } else {
            Serial.print("n/a");
          }
        #endif

        #ifdef _DEBUG_
          Serial.print(", Temperature: ");
          if (Temp_1 > 0) {
            Serial.println(Temp_1);
          } else {
            Serial.println("n/a");
          }
        #endif

        // Display
        //display.clearDisplay();
        //display.drawRoundRect(0,0,128,32,1,SSD1306_WHITE);
        //display.setTextSize(2);
        //display.setTextColor(SSD1306_WHITE);

        //display.setCursor(20,3);
        //display.print(CO2);
        //display.println(" PPm");

        //display.setTextSize(1);
        //display.setCursor(67,22);
        //display.print(Temp_1);
        //display.print(" ");
        //display.write(167);
        //display.print("C");

        // Draw Signal Blocks
        //val = map(CO2, 400, 1500, 1, 5);
        //for(int16_t i=1; i<=5; i+=1) {

        //   if (val <= i){
        //      display.drawRect(5*i,25-i,4,5+i,WHITE);            
        //   } else {
        //      display.fillRect(5*i,25-i,4,5+i,WHITE);
        //   }
        //}
        
        // Enviar a pantalla
        // display.display();
                                  
        getDataTimer = millis();

        // POST Fiware
        if (millis() - getDataPost >= DataPost){

          if(WiFi.status()== WL_CONNECTED){

            http.begin(urlpost);                                                          //Specify request destination    
            http.addHeader("Content-Type", "text/plain");                                 //Specify content-type header
            http.addHeader("Fiware-Service", "<fiware service>");                         //Specify content-type header
            http.addHeader("Fiware-ServicePath", "<fiware service-path>");                //Specify content-type header
            int httpCode = http.POST("ppm|"+String(CO2)+"|temp|"+String(Temp_1));         //Send the request
            String payload = http.getString();
            http.end();
  
            // DEBUG
            #ifdef _DEBUG_
              Serial.print("POST Fiware: ");
              Serial.println(urlpost);
              Serial.print("HTTP POST Code: ");
              Serial.println(httpCode);
            #endif 

          }
                    
          //
          getDataPost = millis();
        }
        
    }

}

//void testdrawbitmap(void) {
//  display.clearDisplay();

//  display.drawBitmap(0,0,myBitmap, 128, 32, 1);
//  display.display();
//  delay(1000);
//}

//
// Preheating Sensor
//
boolean isPreHeating() {  
    return millis() < (MHZ14A_PREHEATING_TIME);
}
